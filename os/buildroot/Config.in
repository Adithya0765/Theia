## os/buildroot/Config.in
```kconfig
# Homestead OS Buildroot external packages.
menu "Homestead packages"
	source "$BR2_EXTERNAL_HOMESTEAD_PATH/package/homestead-session/Config.in"
endmenu
```

## os/buildroot/package/homestead-session/Config.in
```kconfig
config BR2_PACKAGE_HOMESTEAD_SESSION
	bool "homestead-session (consistency + personalization userspace)"
	depends on BR2_PACKAGE_PYTHON3
	help
	  Ships src/homestead prototype + init/session scripts as the
	  Homestead session layer (stage 1+). Compositor wires in later.
```
